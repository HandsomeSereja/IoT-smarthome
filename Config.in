## package/smarthome/Config.in
```kconfig
config BR2_PACKAGE_SMARTHOME
	bool "smarthome"
	depends on BR2_USE_MMU
	select BR2_PACKAGE_LIBGPIOD
	select BR2_PACKAGE_LIBGPIOD_TOOLS
	help
	 Smart home hub application for Raspberry Pi 4.
```
